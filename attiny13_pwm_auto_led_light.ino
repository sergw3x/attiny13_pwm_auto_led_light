#include <util/delay.h>

////////////////////////////////////////////////////////////////////////////////////////////////////////////////////
// PIN configuration
////////////////////////////////////////////////////////////////////////////////////////////////////////////////////
#define PIR_PIN PB4
#define LED_PIN PB0
#define BUTTON_PIN PB1

////////////////////////////////////////////////////////////////////////////////////////////////////////////////////
// Set constants and global variables
////////////////////////////////////////////////////////////////////////////////////////////////////////////////////
// 0-255

#define SPEED_ON 12
#define SPEED_OFF 24
// for PIR sensor
#define TIMEOUT_LED 30000UL
// for button
#define TIMEOUT_DEBOUNCE 70

////////////////////////////////////////////////////////////////////////////////////////////////////////////////////
// Timers
////////////////////////////////////////////////////////////////////////////////////////////////////////////////////
unsigned long CurrentTime = 0;
unsigned long AutoTimeOn = 0;
unsigned long ButtonTimerDebounce = 0;

////////////////////////////////////////////////////////////////////////////////////////////////////////////////////
// FLAGS
////////////////////////////////////////////////////////////////////////////////////////////////////////////////////
// 0 - auto on
// 1 - manual on
// 2 - auto mode
#define AUTO_ON_F 0
#define MANUAL_ON_F 1
#define AUTO_MODE_F 2
uint8_t FLAGS=0b00000100;

////////////////////////////////////////////////////////////////////////////////////////////////////////////////////
// init
////////////////////////////////////////////////////////////////////////////////////////////////////////////////////
void setup() {
  // pin 0 - is output, others is input
  DDRB  = 0b00000001;
  PORTB = 0b00000000;
}

////////////////////////////////////////////////////////////////////////////////////////////////////////////////////
// main loop
////////////////////////////////////////////////////////////////////////////////////////////////////////////////////
void loop() {

   CurrentTime = millis();
   
   //////////////////////////////////////////////////////////////////////////    
   // BUTTON CONTROL
   //////////////////////////////////////////////////////////////////////////
   if((PINB & _BV(BUTTON_PIN)) && !(FLAGS & _BV(MANUAL_ON_F))){
      if(ButtonTimerDebounce==0) ButtonTimerDebounce=CurrentTime;
      if((unsigned long)(ButtonTimerDebounce + TIMEOUT_DEBOUNCE) < CurrentTime){
        // включили переключатель
        if(!(FLAGS & _BV(AUTO_ON_F))) turnOn();
        FLAGS=0b00000010; // set manual on
        ButtonTimerDebounce = 0;
     }
   }else if(!(PINB & _BV(BUTTON_PIN)) && (FLAGS & _BV(MANUAL_ON_F))){
     if(ButtonTimerDebounce==0) ButtonTimerDebounce=CurrentTime;
     if((unsigned long)(ButtonTimerDebounce + TIMEOUT_DEBOUNCE) < CurrentTime){     
        // выключили переключатель
        turnOff();
        FLAGS=0b00000100; // set auto mode on
        ButtonTimerDebounce = 0;
     }
   }else{
     ButtonTimerDebounce = 0;
   }
   
  //////////////////////////////////////////////////////////////////////////
  // PIR sensor
  //////////////////////////////////////////////////////////////////////////
  if(FLAGS & _BV(AUTO_MODE_F)){
    if(PINB & _BV(PIR_PIN)){    
      if(!(FLAGS & _BV(AUTO_ON_F))){
        turnOn();
        FLAGS |= _BV(AUTO_ON_F);
      }
      AutoTimeOn = CurrentTime;
    }else if (!(PINB & _BV(PIR_PIN)) && (FLAGS & _BV(AUTO_ON_F)) && 
                  ((unsigned long)(AutoTimeOn + TIMEOUT_LED)) < CurrentTime){ 
      turnOff();
      FLAGS &= ~_BV(AUTO_ON_F);
    }
  }
  

}


void turnOn(){
  uint8_t i = 0;
  do{
    analogWrite(LED_PIN, i);
    _delay_ms(SPEED_ON);                            
  }while (++i);
}

void turnOff(){
  uint8_t i = 255;
  do{
    analogWrite(LED_PIN, i);
    _delay_ms(SPEED_OFF);                            
  }while (i--);
}
